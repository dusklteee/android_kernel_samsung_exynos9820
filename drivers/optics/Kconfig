## drivers/optics/Kconfig
```kconfig
#
# optics drivers configuration
#

config SENSORS_HRMSENSOR
	tristate "HRM Sensor Driver Common"
	default n
	depends on I2C
	help
	  If you say yes here you get support for the HRM sensor.
	  This feature is common feature for supporting HRM sensor.
	  This driver can also be built as a module.  If so, the module
	  will be called hrmsensor.

config SENSORS_HRM_MAX86915
	tristate "HRM Sensor Driver MAX86915"
	default n
	depends on SENSORS_HRMSENSOR
	help
	  If you say yes here you get support for the HRM sensor.
	  This driver should be set with SENSORS_HRMSENSOR.
	  This driver can also be built as a module.  If so, the module
	  will be called max86915.

config SENSORS_MAX86915
	tristate "HRM Sensor Driver MAX86915"
	default n
	depends on I2C
	help
	  If you say yes here you get support for the HRM sensor.
	  This driver can also be built as a module.  If so, the module
	  will be called max86915.

config MAX86915_POWERSHARE_LED
	bool "PowerShare indicator on the rear HRM LEDs"
	default n
	depends on SENSORS_MAX86915=y && BATTERY_SAMSUNG_V2=y
	help
	  Drive the rear HRM LEDs as a Wireless PowerShare (reverse charging)
	  status indicator, mirroring the stock ROM: blue while waiting for a
	  receiver, red while charging one. The Samsung battery driver notifies
	  the HRM sensor driver on PowerShare state changes.

	  Both drivers must be built-in (=y) so the exported hook links.

config SENSORS_TCS3407
	tristate "AMS TCS3407 MoBeam, RemCon, ALS, Proximity, Color, Flicker sensor"
	depends on I2C && SYSFS
	help
	  If you say yes here you get support for the AMS TCS3407
	  mobeam, ambient light, proximity, color, and flicker sensors.

	  This driver can also be built as a module.  If so, the module
	  will be called TCS3407.

config SENSORS_VD6281
	tristate "STM VD6281 ALS, Color, Flicker sensor"
	depends on I2C && SYSFS
	help
	  If you say yes here you get support for the STM VD6281
	  ambient light, color, and flicker sensors.

	  This driver can also be built as a module.  If so, the module
	  will be called VD6281.
```

## drivers/thermal/samsung/Kconfig
```kconfig
config EXYNOS_THERMAL
	tristate "Exynos thermal management unit driver"
	depends on THERMAL_OF
	depends on HAS_IOMEM
	help
	  If you say yes here you get support for the TMU (Thermal Management
	  Unit) driver for SAMSUNG EXYNOS series of SoCs. This driver initialises
	  the TMU, reports temperature and handles cooling action if defined.
	  This driver uses the Exynos core thermal APIs and TMU configuration
	  data from the supported SoCs.

config EXYNOS_ACPM_THERMAL
	bool
	prompt "Exynos ACPM TMU plug-in support"
	depends on EXYNOS_THERMAL
	help
	  This feature supports ACPM TMU plug-in for Exynos thermal driver.


config EXYNOS_TMU_CPU_PASSIVE_TEMP
	int "CPU throttling setpoint, in millicelsius (0 = keep the ECT value)"
	depends on EXYNOS_THERMAL && ECT
	default 0
	help
	  Temperature at which the CPU thermal zones start throttling. The
	  stock value on Exynos 9820 is 83000, and it comes from the ECT blob,
	  which overrides whatever the device tree declares - so this cannot be
	  changed from the DTS, and the device tree lives in its own partition.
	  Setting it here needs no partition write.

	  Only the trip marked "passive" is affected. The active alerts at
	  95/100/105/110C, the hot trip at 115C and the core hotplug thresholds
	  are left exactly as the ECT set them, and values at or above 95000
	  are rejected outright.

	  The trip stays writable at runtime through
	  /sys/class/thermal/thermal_zoneN/trip_point_M_temp, so this is only
	  the boot default.

	  Say 0 to keep stock behaviour.

config EXYNOS_TMU_GPU_PASSIVE_TEMP
	int "GPU throttling setpoint, in millicelsius (0 = keep the ECT value)"
	depends on EXYNOS_THERMAL && ECT
	default 0
	help
	  Same as EXYNOS_TMU_CPU_PASSIVE_TEMP, but for the G3D zone. Kept
	  separate because the Mali-G76 on this SoC starts from a higher stock
	  setpoint (88000) and has a history of instability under sustained 3D
	  load, so raising it deserves its own decision.

	  Say 0 to keep stock behaviour.
```
